## nano-buildroot/Config.in
```kconfig
source "$BR2_EXTERNAL_LICHEEPI_NANO_PATH/package/python-pyopengl/Config.in"
source "$BR2_EXTERNAL_LICHEEPI_NANO_PATH/package/python-pysdl2/Config.in"
source "$BR2_EXTERNAL_LICHEEPI_NANO_PATH/package/python-pegl/Config.in"
source "$BR2_EXTERNAL_LICHEEPI_NANO_PATH/package/python-imgui/Config.in"
```

## nano-buildroot/configs/licheepi_nano_defconfig
```kconfig
#
# ARMv5 compilation target
#
BR2_arm=y
BR2_ARCH="arm"
BR2_ENDIAN="LITTLE"
BR2_GCC_TARGET_ABI="aapcs-linux"
BR2_GCC_TARGET_CPU="arm926ej-s"
BR2_GCC_TARGET_FLOAT_ABI="soft"
BR2_GCC_TARGET_MODE="arm"
BR2_ARM_CPU_MAYBE_HAS_FPU=y
BR2_ARM_CPU_MAYBE_HAS_VFPV2=y
BR2_ARM_CPU_HAS_ARM=y
BR2_ARM_CPU_HAS_THUMB=y
BR2_ARM_CPU_ARMV5=y
BR2_arm926t=y

#
# Debug messages for BR2 downloads
#
BR2_ENABLE_DEBUG=y

#
# Internal Buildroot toolchain, with headers matching custom kernel
#
BR2_TOOLCHAIN_BUILDROOT_GLIBC=y
BR2_PACKAGE_HOST_LINUX_HEADERS_CUSTOM_5_4=y
BR2_PACKAGE_GLIBC_UTILS=y
BR2_TOOLCHAIN_BUILDROOT_CXX=y
BR2_TOOLCHAIN_EXTRA_LIBS="libatomic"

#
# OS name and login settings
#
BR2_TARGET_GENERIC_HOSTNAME="licheepi-nano"
BR2_TARGET_GENERIC_ISSUE="Welcome to LicheePi Nano"
BR2_TARGET_GENERIC_ROOT_PASSWD="root"
BR2_TARGET_GENERIC_GETTY_PORT="/dev/ttyS0"
BR2_TARGET_GENERIC_GETTY_BAUDRATE_115200=y

#
# Linux kernel customized for the board
#
BR2_LINUX_KERNEL=y
BR2_LINUX_KERNEL_CUSTOM_GIT=y

# @unframework Linux fork and tag
# (cherry-picked from Lichee-Pi Linux fork nano-5.2-flash branch as of 2021-03-06)
BR2_LINUX_KERNEL_CUSTOM_REPO_URL="https://github.com/unframework/linux"
BR2_LINUX_KERNEL_CUSTOM_REPO_VERSION="v5.11-nano-2"

# original Lichee-Pi Linux fork and branch without Flash-specific config changes
# BR2_LINUX_KERNEL_CUSTOM_REPO_URL="https://github.com/Lichee-Pi/linux"
# BR2_LINUX_KERNEL_CUSTOM_REPO_VERSION="nano-5.2-tf"

BR2_LINUX_KERNEL_USE_CUSTOM_CONFIG=y
BR2_LINUX_KERNEL_CUSTOM_CONFIG_FILE="$(BR2_EXTERNAL_LICHEEPI_NANO_PATH)/board/licheepi_nano/licheepi_nano_linux_defconfig"

# original Lichee-Pi Linux fork provided defconfig
# BR2_LINUX_KERNEL_DEFCONFIG="licheepi_nano"

# custom DTS file with 480x272 LCD driver settings
BR2_LINUX_KERNEL_DTS_SUPPORT=y
BR2_LINUX_KERNEL_CUSTOM_DTS_PATH="$(BR2_EXTERNAL_LICHEEPI_NANO_PATH)/board/licheepi_nano/suniv-f1c100s-licheepi-nano-lcd480.dts"

#
# Python setup
#
BR2_PACKAGE_PYTHON3=y
BR2_PACKAGE_PYTHON3_PYC_ONLY=y
BR2_PACKAGE_PYTHON_PIP=y
BR2_PACKAGE_PYTHON_PYOPENGL=y
BR2_PACKAGE_PYTHON_PYSDL2=y
BR2_PACKAGE_PYTHON_IMGUI=y

#
# Graphics packages
#
BR2_PACKAGE_JPEG=y
BR2_PACKAGE_LIBPNG=y
BR2_PACKAGE_MESA3D=y
BR2_PACKAGE_MESA3D_DRI_DRIVER_SWRAST=y
BR2_PACKAGE_MESA3D_OPENGL_GLX=y
BR2_PACKAGE_MESA3D_OPENGL_EGL=y
BR2_PACKAGE_SDL2=y
BR2_PACKAGE_SDL2_OPENGL=y
BR2_PACKAGE_SDL2_GFX=y
BR2_PACKAGE_SDL2_IMAGE=y
BR2_PACKAGE_XORG7=y
BR2_PACKAGE_XSERVER_XORG_SERVER=y
BR2_PACKAGE_XDRIVER_XF86_INPUT_KEYBOARD=y
BR2_PACKAGE_XDRIVER_XF86_VIDEO_FBDEV=y
BR2_PACKAGE_ZIP=y

#
# Build root FS ext2 (for TF card)
#
BR2_TARGET_ROOTFS_EXT2=y
BR2_TARGET_ROOTFS_EXT2_4=y
BR2_TARGET_ROOTFS_EXT2_SIZE="150M"

# BR2_TARGET_ROOTFS_TAR is not set

BR2_ROOTFS_DEVICE_CREATION_DYNAMIC_MDEV=y

#
# Package up the images for deployment to board
#
BR2_ROOTFS_POST_IMAGE_SCRIPT="$(BR2_EXTERNAL_LICHEEPI_NANO_PATH)/board/licheepi_nano/post-image.sh"

#
# U-Boot customized for the board
#
BR2_TARGET_UBOOT=y
BR2_TARGET_UBOOT_BOARDNAME="licheepi_nano"
BR2_TARGET_UBOOT_CUSTOM_GIT=y

# @unframework U-Boot fork and tag
# (rebased from @Icenowy U-Boot fork f1c100s-spiflash branch as of 2021-03-06, plus others)
BR2_TARGET_UBOOT_CUSTOM_REPO_URL="https://github.com/unframework/u-boot"
BR2_TARGET_UBOOT_CUSTOM_REPO_VERSION="v2021.01-f1c100s-4"

# original Lichee-Pi U-Boot fork and branch
# BR2_TARGET_UBOOT_CUSTOM_REPO_URL="https://github.com/Lichee-Pi/u-boot"
# BR2_TARGET_UBOOT_CUSTOM_REPO_VERSION="nano-v2018.01"

BR2_TARGET_UBOOT_NEEDS_DTC=y
BR2_TARGET_UBOOT_NEEDS_PYLIBFDT=y

# BR2_TARGET_UBOOT_FORMAT_BIN is not set
BR2_TARGET_UBOOT_FORMAT_CUSTOM=y
BR2_TARGET_UBOOT_FORMAT_CUSTOM_NAME="u-boot-sunxi-with-spl.bin"
BR2_TARGET_UBOOT_BOOT_SCRIPT=y
BR2_TARGET_UBOOT_BOOT_SCRIPT_SOURCE="$(BR2_EXTERNAL_LICHEEPI_NANO_PATH)/board/licheepi_nano/boot.cmd"

#
# Extra host dependencies to build images
#
BR2_PACKAGE_HOST_GENIMAGE=y
BR2_PACKAGE_HOST_MTOOLS=y
```

## nano-buildroot/package/python-imgui/Config.in
```kconfig
config BR2_PACKAGE_PYTHON_IMGUI
	bool "python-imgui"
	help
	  Cython-based Python bindings for dear imgui.

	  https://github.com/swistakm/pyimgui
```

## nano-buildroot/package/python-pegl/Config.in
```kconfig
config BR2_PACKAGE_PYTHON_PEGL
	bool "python-pegl"
	help
	  Python 3 wrapper for the EGL API.

	  https://github.com/perey/pegl
```

## nano-buildroot/package/python-pyopengl/Config.in
```kconfig
config BR2_PACKAGE_PYTHON_PYOPENGL
	bool "python-pyopengl"
	help
	  Standard OpenGL bindings for Python.

	  http://pyopengl.sourceforge.net
```

## nano-buildroot/package/python-pysdl2/Config.in
```kconfig
config BR2_PACKAGE_PYTHON_PYSDL2
	bool "python-pysdl2"
	help
	  Python SDL2 bindings.

	  https://github.com/marcusva/py-sdl2
```
